## boards/shields/poc/Kconfig.shield
```kconfig
config SHIELD_POC_LEFT
    def_bool $(shields_list_contains,poc_left)

config SHIELD_POC_RIGHT
    def_bool $(shields_list_contains,poc_right)

config SHIELD_POC_DONGLE
    def_bool $(shields_list_contains,poc_dongle)
```
